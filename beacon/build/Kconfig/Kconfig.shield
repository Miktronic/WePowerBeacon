## beacon/build/Kconfig/Kconfig.shield
```kconfig
osource "d:/wepowerbeacon/beacon/boards/shields/*/Kconfig.shield"
osource "./boards/shields/*/Kconfig.shield"
osource "D:/WePowerBeacon/beacon/./boards/shields/*/Kconfig.shield"
osource "C:/ncs/v2.4.2/nrf/boards/shields/*/Kconfig.shield"
```

## beacon/build/Kconfig/Kconfig.shield.defconfig
```kconfig
osource "d:/wepowerbeacon/beacon/boards/shields/*/Kconfig.defconfig"
osource "C:/ncs/v2.4.2/nrf/boards/shields/*/Kconfig.defconfig"
```
